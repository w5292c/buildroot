## configs/atngw100_custom_defconfig
```kconfig
# AVR32 is deprecated
BR2_DEPRECATED=y

# Architecture
BR2_avr32=y

# Lock down kernel headers version, to match the kernel version used
# below.
BR2_KERNEL_HEADERS_VERSION=y
BR2_DEFAULT_KERNEL_VERSION="4.0"
BR2_PACKAGE_HOST_LINUX_HEADERS_CUSTOM_4_0=y

# Filesystems
BR2_TARGET_ROOTFS_JFFS2=y
BR2_TARGET_ROOTFS_JFFS2_FLASH_128=y
BR2_TARGET_ROOTFS_JFFS2_PAGESIZE=0x1000
BR2_TARGET_ROOTFS_JFFS2_EBSIZE=0x20000
BR2_TARGET_ROOTFS_JFFS2_NOCLEANMARKER=y
BR2_TARGET_ROOTFS_JFFS2_BE=y
BR2_TARGET_ROOTFS_TAR=y
BR2_TARGET_ROOTFS_TAR_NONE=y

# Bootloader
BR2_TARGET_UBOOT=y
BR2_TARGET_UBOOT_BOARDNAME="atngw100"
BR2_TARGET_UBOOT_CUSTOM_VERSION=y
BR2_TARGET_UBOOT_CUSTOM_VERSION_VALUE="2010.09"

# Kernel. Locked to 3.9.x, because 3.10.x fails to build with
# relocation truncated to fit: R_AVR32_16N_PCREL against symbol
# `_ctype'
BR2_LINUX_KERNEL=y
BR2_LINUX_KERNEL_CUSTOM_GIT=y
BR2_LINUX_KERNEL_CUSTOM_REPO_URL="https://github.com/w5292c/linux-v4.0.git"
BR2_LINUX_KERNEL_CUSTOM_REPO_VERSION="f75466d62f17fb9dae0846f5f6c8f61b94390b4a"
BR2_LINUX_KERNEL_USE_DEFCONFIG=y
BR2_LINUX_KERNEL_DEFCONFIG="atngw100_custom"
BR2_LINUX_KERNEL_ZIMAGE=y

# uClibc Options
BR2_TOOLCHAIN_BUILDROOT_WCHAR=y
BR2_TOOLCHAIN_BUILDROOT_LOCALE=y

# Text editors
BR2_PACKAGE_NANO=y

# Other packagers
BR2_PACKAGE_PWGEN=y
BR2_PACKAGE_FLEX=y
BR2_PACKAGE_GETTEXT=y
BR2_PACKAGE_HTOP=y
BR2_PACKAGE_LIBPTHREAD_STUBS=y
BR2_PACKAGE_EXPAT=y
BR2_PACKAGE_PIXMAN=y
BR2_PACKAGE_LIBPNG=y
BR2_PACKAGE_JPEG=y
BR2_PACKAGE_LIBJPEG=y
BR2_PACKAGE_HAS_JPEG=y
BR2_PACKAGE_PROVIDES_JPEG="libjpeg"
BR2_PACKAGE_FONTCONFIG=y
BR2_PACKAGE_FREETYPE=y
BR2_PACKAGE_GIFLIB=y
BR2_PACKAGE_XSERVER_XORG_SERVER_XVFB=y
BR2_PACKAGE_XLIB_LIBICE=y
BR2_PACKAGE_XLIB_LIBSM=y
BR2_PACKAGE_XLIB_LIBXAW=y
BR2_PACKAGE_XLIB_LIBXMU=y
BR2_PACKAGE_XLIB_LIBXPM=y
BR2_PACKAGE_XLIB_LIBXT=y
BR2_PACKAGE_XLIB_LIBXTST=y
BR2_PACKAGE_XPROTO_RECORDPROTO=y
BR2_PACKAGE_XTERM=y
BR2_PACKAGE_MATCHBOX=y
BR2_PACKAGE_MATCHBOX_PANEL=y
BR2_PACKAGE_MATCHBOX_DESKTOP=y
BR2_PACKAGE_MATCHBOX_COMMON=y
BR2_PACKAGE_MATCHBOX_COMMON_PDA=y
BR2_PACKAGE_MATCHBOX_KEYBOARD=y


# Framebuffer
BR2_PACKAGE_FBDUMP=y
BR2_PACKAGE_FBGRAB=y
BR2_PACKAGE_FB_TEST_APP=y
BR2_PACKAGE_FBV=y
BR2_PACKAGE_FBV_PNG=y
BR2_PACKAGE_FBV_JPEG=y
BR2_PACKAGE_FBV_GIF=y

#X Server
BR2_PACKAGE_XORG7=y
BR2_PACKAGE_XSERVER_XORG_SERVER=y

# Games
BR2_PACKAGE_GNUCHESS=y
BR2_PACKAGE_LTRIS=y
BR2_PACKAGE_LTRIS_AUDIO=n
```
